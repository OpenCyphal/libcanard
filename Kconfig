## Kconfig
```kconfig
# This file defines customizable build options
# if libcanard is used as an ESP-IDF component.
# Configure these values by running 'idf.py menuconfig' in this
# directory.

menu "Libcanard"

config CANARD_ASSERTIONS
    bool "Enable libcanard assertions."
    default y
    help
        Set to 'n' to disable libcanard assertions.

config CANARD_CRC_TABLE
    bool "Enable libcanard CRC table"
    default y
    help
        Set to 'n' to use slow but ROM-efficient transfer-CRC computation algorithm.
        Doing so is expected to save ca. 500 bytes of ROM and
        increase the cost of RX/TX transfer processing by ~half.


endmenu
```
